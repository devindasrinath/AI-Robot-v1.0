## esp32/sdkconfig.defaults
```kconfig
# ESP32-C3 target
CONFIG_IDF_TARGET="esp32c3"

# FreeRTOS tick rate 1000Hz for 1ms precision
CONFIG_FREERTOS_HZ=1000

# UART buffer sizes
CONFIG_ESP_CONSOLE_UART_BAUDRATE=115200

# SPI DMA
CONFIG_SPI_MASTER_IN_IRAM=y

# Optimize for performance
CONFIG_COMPILER_OPTIMIZATION_PERF=y
```

## esp32_display/sdkconfig.defaults
```kconfig
CONFIG_IDF_TARGET="esp32c3"
CONFIG_FREERTOS_HZ=1000
CONFIG_COMPILER_OPTIMIZATION_PERF=y
CONFIG_ESP_CONSOLE_UART_BAUDRATE=115200
```
